## config/west.yml
```yaml
manifest:
  remotes:
    - name: zmkfirmware
      url-base: https://github.com/zmkfirmware
    - name: urob
      url-base: https://github.com/urob
    # Additional modules containing boards/shields/custom code can be listed here as well
    # See https://docs.zephyrproject.org/3.2.0/develop/west/manifest.html#projects
  projects:
    - name: zmk
      remote: zmkfirmware
      revision: v0.2 # set to desired version 
      import: app/west.yml
    - name: zmk-tri-state
      remote: urob
      revision: main
    - name: zmk-auto-layer
      remote: urob
      revision: v0.2 # set to same version as zmk above
  self:
    path: config
```
