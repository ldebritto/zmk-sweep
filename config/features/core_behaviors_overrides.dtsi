// Customizing some core behaviors from their defaults

&sk {  
    quick-release;                      // Avoids "THis" problem (double capitalization)
    release-after-ms = <86400000>;      // Default is 1000 ms, raised to 1 day to emulate Callum's behavior that requires canceling on layer key.
};

// &caps_word is no longer used - see &caps_al in custom_behaviors.dtsi and the CAPSW layer.
// Two reasons it could never be fixed here: ZMK dropped the ignore-modifiers property from
// zmk,behavior-caps-word.yaml (so /delete-property/ was a no-op), and its listener short-circuits
// on is_mod(), which is hardcoded - a modifier press can never deactivate it.

&mt { flavor = "balanced"; };
&lt { flavor = "balanced"; };
