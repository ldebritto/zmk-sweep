// Customized hold-tap definitions
        
        hrml: hrml { // urob's home row mods left
            compatible = "zmk,behavior-hold-tap";
            label = "HRML";
            bindings = <&kp>, <&kp>;

            #binding-cells = <2>;
            hold-trigger-key-positions = <5 6 7 8 9 15 16 17 18 19 25 26 27 28 29 30 31 32 33>; // right-side + thumbs
            flavor = "balanced";
            tapping-term-ms = <280>;
            hold-trigger-on-release;
            quick-tap-ms = <200>;
            require-prior-idle-ms = <200>;
        };

        hrmr: hrmr { // urob's home row mods right
            compatible = "zmk,behavior-hold-tap";
            label = "HRMR";
            bindings = <&kp>, <&kp>;

            #binding-cells = <2>;
            flavor = "balanced";
            tapping-term-ms = <280>;
            hold-trigger-key-positions = <0 1 2 3 4 10 11 12 13 14 20 21 22 23 24 30 31 32 33>; // left-side + thumbs
            hold-trigger-on-release;
            quick-tap-ms = <200>;
            require-prior-idle-ms = <200>;
        };

        // Customized balanced layer-tap

        ltl: better_layer_tap_left { // urob's logic but for a layer-tap on left hand
            compatible = "zmk,behavior-hold-tap";
            label = "LTL";
            bindings = <&lc>, <&kp>;

            #binding-cells = <2>;
            hold-trigger-key-positions = <5 6 7 8 9 15 16 17 18 19 25 26 27 28 29 30 31 32 33>; // right-side + thumbs
            flavor = "balanced";
            tapping-term-ms = <280>;
            hold-trigger-on-release;
            quick-tap-ms = <200>;
            require-prior-idle-ms = <200>;
        };

        ltr: better_layer_tap_right { // urob's logic but for a layer-tap on right hand
            compatible = "zmk,behavior-hold-tap";
            label = "LTR";
            bindings = <&lc>, <&kp>;

            #binding-cells = <2>;
            hold-trigger-key-positions = <0 1 2 3 4 10 11 12 13 14 20 21 22 23 24 30 31 32 33>; // left-side + thumbs
            flavor = "balanced";
            tapping-term-ms = <280>;
            hold-trigger-on-release;
            quick-tap-ms = <200>;
            require-prior-idle-ms = <200>;
        };