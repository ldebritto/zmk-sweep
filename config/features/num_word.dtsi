#include <behaviors/num_word.dtsi> // requires auto-layer module (https://github.com/urob/zmk-auto-layer)
&num_word { // great to quick entry of numbers requires auto-layer module (https://github.com/urob/zmk-auto-layer)
  continue-list = <
    DOLLAR DOT COMMA SQT COLON
    PLUS MINUS ASTRK SLASH EQUAL 
    LPAR RPAR LBKT RBKT LBRC RBRC LT GT 
    BSPC DEL ESC 
    LCTRL LALT LSHFT LGUI
    RCTRL RALT       RGUI
    >; // These keys will NOT cancel the num_ word auto-layer
};