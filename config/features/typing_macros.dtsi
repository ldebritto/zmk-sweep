// NUM Macros

reais: reais {
    compatible = "zmk,behavior-macro";
    #binding-cells = <0>; // Must be 0
    wait-ms = <20>;
    tap-ms = <15>;
    bindings = <&macro_tap &kp LS(R) &kp LS(N4) &kp SPACE>;
};

comma00: comma00 {
    compatible = "zmk,behavior-macro";
    #binding-cells = <0>; // Must be 0
    wait-ms = <20>;
    tap-ms = <15>;
    bindings = <&macro_tap &kp COMMA &kp N0 &kp N0>;
};

triple0: triple0 {
    compatible = "zmk,behavior-macro";
    #binding-cells = <0>; // Must be 0
    wait-ms = <20>;
    tap-ms = <15>;
    bindings = <&macro_tap &kp N0 &kp N0 &kp N0>;
};